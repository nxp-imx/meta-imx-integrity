## conf/layer.conf
```bitbake
BBPATH .= ":${LAYERDIR}"

# We have recipes-* directories, add to BBFILES
BBFILES += "${LAYERDIR}/recipes-*/*/*.bb \
            ${LAYERDIR}/recipes-*/*/*.bbappend"

BBFILE_COLLECTIONS += "meta-imx-integrity"
BBFILE_PATTERN_meta-imx-integrity = "^${LAYERDIR}/"
BBFILE_PRIORITY_meta-imx-integrity = "6"
LAYERVERSION_meta-imx-integrity = "4"
LAYERSERIES_COMPAT_meta-imx-integrity = "kirkstone langdale mickledore"
LAYERSERIES_COMPAT_parsec-layer:append = " langdale mickledore"
LAYERSERIES_COMPAT_tpm-layer:append = " langdale mickledore"
LAYERSERIES_COMPAT_integrity:append = " langdale mickledore"
```
